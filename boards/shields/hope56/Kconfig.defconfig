## boards/shields/hope56/Kconfig.defconfig
```kconfig
if SHIELD_HOPE56_LEFT

# Name must be less than 16 characters long!
config ZMK_HOPE56
bool
    default "hope56"

config ZMK_SPLIT_ROLE_CENTRAL
    default y

endif

if SHIELD_HOPE56_LEFT || SHIELD_HOPE56_RIGHT

config ZMK_SPLIT
    default y

endif
```

## boards/shields/hope56/Kconfig.shield
```kconfig
# No whitespace after the comma or in your part name!
config SHIELD_HOPE56_LEFT
    def_bool $(shields_list_contains,hope56_left)

# No whitespace after the comma or in your part name!
config SHIELD_HOPE56_RIGHT
    def_bool $(shields_list_contains,hope56_right)
```
