#include "hope56.dtsi" // The shared dtsi file is included in the overlay

&default_transform { // Offset of 4 because the left side has 4 columns
    col-offset = <6>;
};

// Label of the kscan node in the dtsi
&kscan0 {
    col-gpios
        = <&pro_micro 7 GPIO_ACTIVE_HIGH>
        , <&pro_micro 6 GPIO_ACTIVE_HIGH>
        , <&pro_micro 5 GPIO_ACTIVE_HIGH>
        , <&pro_micro 4 GPIO_ACTIVE_HIGH>
        , <&pro_micro 3 GPIO_ACTIVE_HIGH>
        , <&pro_micro 2 GPIO_ACTIVE_HIGH>
        ;
};
