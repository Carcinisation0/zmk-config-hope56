#include "hope56.dtsi"

&kscan0 {
    row-gpios
        = <&pro_micro 15 (GPIO_ACTIVE_HIGH | GPIO_PULL_DOWN)> // 113 top
        , <&pro_micro 19 (GPIO_ACTIVE_HIGH | GPIO_PULL_DOWN)> // 002
        , <&pro_micro 20 (GPIO_ACTIVE_HIGH | GPIO_PULL_DOWN)> // 029
        , <&pro_micro 21 (GPIO_ACTIVE_HIGH | GPIO_PULL_DOWN)> // 031
        , <&pro_micro 18 (GPIO_ACTIVE_HIGH | GPIO_PULL_DOWN)> // 115 bottom
        ;
    col-gpios
        = <&pro_micro 7 GPIO_ACTIVE_HIGH> // 011 left
        , <&pro_micro 6 GPIO_ACTIVE_HIGH> // 100
        , <&pro_micro 5 GPIO_ACTIVE_HIGH> // 024
        , <&pro_micro 4 GPIO_ACTIVE_HIGH> // 022
        , <&pro_micro 3 GPIO_ACTIVE_HIGH> // 020
        , <&pro_micro 2 GPIO_ACTIVE_HIGH> // 017 right
        ;
};
