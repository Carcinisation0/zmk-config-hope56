#pragma once

#include <behaviors.dtsi>
#include <dt-bindings/zmk/keys.h>

/ {
    macros {
        del_word: del_word {
            compatible = "zmk,behavior-macro";
            #binding-cells = <0>;
            label = "DEL_WORD";
            wait-ms = <5>;
            tap-ms = <5>;
            bindings
                = <&kp LS(LC(LEFT))>
                , <&kp BSPC>
                ;
        };

wrap_paren: wrap_paren {
    compatible = "zmk,behavior-macro";
    #binding-cells = <0>;
    wait-ms = <40>;
    tap-ms = <20>;
    bindings =
        <&kp LC(X)>,
        <&kp LPAR>, <&kp RPAR>, <&kp LEFT>,
        <&kp LC(V)>;
};

    };
};
